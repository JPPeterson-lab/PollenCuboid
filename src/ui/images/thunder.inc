// This file was generated by SquareLine Studio
// SquareLine Studio version: SquareLine Studio 1.6.1
// LVGL version: 8.3.11
// Project name: wetterklein


#ifndef LV_ATTRIBUTE_MEM_ALIGN
#define LV_ATTRIBUTE_MEM_ALIGN
#endif

// IMAGE DATA: assets/thunder.png
const LV_ATTRIBUTE_MEM_ALIGN uint8_t ui_img_thunder_png_data[]  = {
0x00,0x00,0x00,0x00,0x00,0x00,0x00,0x00,0x00,0x3A,0xBE,0x0E,0x3A,0xBE,0xCC,0xBB,0xCE,0xFF,0xFC,0xD6,0xFF,0xFC,0xD6,0xFF,0xFC,0xD6,0xFF,0xFC,0xD6,0xFF,0xFC,0xD6,0xFF,0xFC,0xD6,0xFF,0xFC,0xD6,0xFF,0xFC,0xD6,0xFF,0xFC,0xD6,0xFF,0xFC,0xD6,0xFF,0xFC,0xD6,0xFF,0xFC,0xD6,0xFF,0xFC,0xD6,0xFF,0xBB,0xCE,0xFF,0x3A,0xBE,0xCC,0x3A,0xBE,0x0E,0x00,0x00,0x00,0x00,0x00,0x00,0x00,0x00,0x00,0x00,0x00,0x00,0x00,0x00,0x00,0x00,0x00,0x00,0x00,0x00,0x00,0x00,0x00,0x00,0x00,0x00,0x00,0x00,0x00,0x00,0x00,0x00,0x00,0x00,0x00,0x00,0x00,0x00,0x00,0x00,0x00,0x00,0x00,0x00,0x00,0x00,0x00,0x00,0x00,0x00,0x00,0x00,0x00,0x00,0x00,0x00,0x00,0x00,0x00,0x00,0x3A,0xBE,0x02,0x5A,0xBE,0x9A,0xBB,0xCE,0xFF,0xFC,0xD6,0xFF,0xFC,0xD6,0xFF,0xFC,0xD6,0xFF,0xFC,0xD6,0xFF,0xFC,0xD6,0xFF,0xFC,0xD6,0xFF,0xFC,0xD6,0xFF,0xFC,0xD6,0xFF,0xFC,0xD6,0xFF,0xFC,0xD6,0xFF,0xFC,0xD6,0xFF,0xFC,0xD6,0xFF,0xFC,0xD6,0xFF,0xFC,0xD6,0xFF,0xFC,0xD6,0xFF,0xBB,0xCE,0xFF,0x5A,0xBE,0x9A,0x3A,0xBE,0x02,0x00,0x00,0x00,
    0x00,0x00,0x00,0x00,0x00,0x00,0x00,0x00,0x00,0x00,0x00,0x00,0x00,0x00,0x00,0x00,0x00,0x00,0x00,0x00,0x00,0x00,0x00,0x00,0x00,0x00,0x00,0x00,0x00,0x00,0x00,0x00,0x00,0x00,0x00,0x00,0x00,0x00,0x00,0x00,0x00,0x00,0x00,0x00,0x00,0x00,0x00,0x00,0x3A,0xBE,0xBD,0x3A,0xBE,0x96,0x3A,0xBE,0x69,0xBB,0xCE,0xFA,0xFC,0xD6,0xFF,0xFC,0xD6,0xFF,0xFC,0xD6,0xFF,0xFC,0xD6,0xFF,0xFC,0xD6,0xFF,0xFC,0xD6,0xFF,0xFC,0xD6,0xFF,0xFC,0xD6,0xFF,0xFC,0xD6,0xFF,0xFC,0xD6,0xFF,0xFC,0xD6,0xFF,0xFC,0xD6,0xFF,0xFC,0xD6,0xFF,0xFC,0xD6,0xFF,0xFC,0xD6,0xFF,0xFC,0xD6,0xFF,0xFC,0xD6,0xFF,0xBB,0xCE,0xFA,0x3A,0xBE,0x66,0x3A,0xBE,0x96,0x3A,0xBE,0xBD,0x3A,0xBE,0xBF,0x3A,0xBE,0x9E,0x3A,0xBE,0x42,0x3A,0xBE,0x05,0x00,0x00,0x00,0x00,0x00,0x00,0x00,0x00,0x00,0x00,0x00,0x00,0x00,0x00,0x00,0x00,0x00,0x00,0x00,0x00,0x00,0x00,0x00,0x00,0x00,0x00,0x00,0x00,0x00,0x00,0x00,0x00,0x00,0xBB,0xCE,0xFF,0x9B,0xC6,0xFF,0x7A,0xC6,0xFF,0xFC,0xD6,0xFF,0xFC,0xD6,0xFF,0xFC,0xD6,0xFF,0xFC,0xD6,0xFF,0xFC,0xD6,0xFF,
    0xFC,0xD6,0xFF,0xDB,0xCE,0xFF,0x9B,0xC6,0xFF,0x5A,0xC6,0xFF,0x5A,0xC6,0xFF,0x7A,0xC6,0xFF,0x9B,0xC6,0xFF,0xDB,0xCE,0xFF,0xFC,0xD6,0xFF,0xFC,0xD6,0xFF,0xFC,0xD6,0xFF,0xFC,0xD6,0xFF,0xFC,0xD6,0xFF,0xFC,0xD6,0xFF,0x7A,0xC6,0xFF,0x9B,0xC6,0xFF,0xBB,0xCE,0xFF,0xBB,0xCE,0xFF,0x9B,0xCE,0xFF,0x5A,0xC6,0xFD,0x3A,0xBE,0xC3,0x3A,0xBE,0x33,0x00,0x00,0x00,0x00,0x00,0x00,0x00,0x00,0x00,0x00,0x00,0x00,0x00,0x00,0x00,0x00,0x00,0x00,0x00,0x00,0x00,0x00,0x00,0x00,0x00,0x00,0x00,0x00,0x00,0x00,0xFC,0xD6,0xFF,0xFC,0xD6,0xFF,0xFC,0xD6,0xFF,0xFC,0xD6,0xFF,0xFC,0xD6,0xFF,0xFC,0xD6,0xFF,0xFC,0xD6,0xFF,0xFC,0xD6,0xFF,0x9B,0xC6,0xFF,0x3A,0xBE,0xFF,0x7B,0xC6,0xFF,0x9B,0xCE,0xFF,0xBB,0xCE,0xFF,0x9B,0xCE,0xFF,0x7A,0xC6,0xFF,0x3A,0xBE,0xFF,0x9B,0xCE,0xFF,0xFC,0xD6,0xFF,0xFC,0xD6,0xFF,0xFC,0xD6,0xFF,0xFC,0xD6,0xFF,0xFC,0xD6,0xFF,0xFC,0xD6,0xFF,0xFC,0xD6,0xFF,0xFC,0xD6,0xFF,0xFC,0xD6,0xFF,0xFC,0xD6,0xFF,0xFC,0xD6,0xFF,0xBB,0xCE,0xFF,0x5A,0xC6,0xF3,0x3A,0xBE,0x2C,0x00,0x00,0x00,
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    0x00,0x00,0x00,0x00,0x00,0x00,0x00,0x00,0x00,0x00,0x00,0x00,0x00,0x00,0x00,0x00,0x00,0x00,0x00,0x00,0x00,0x00,0x00,0x00,0x00,0x00,0x00,0x00,0x00,0x00,0x00,0x00,0x00,0x00,0x00,0x00,0x00,0x00,0x00,0x00,0x00,0x00,0x00,0x00,0x00,0x00,0x00,0x00,0x00,0x00,0x00,0x00,0x00,0x00,0x00,0x00,0x00,0x00,0x00,0x00,0x00,0x00,0x00,0x00,0x00,0x00,0x00,0x00,0x00,0x00,0x00,0x00,0x00,0x00,0x00,0x00,0x00,0x00,0x00,0x00,0x00,0x00,0x00,0x00,0x00,0x00,0x00,0x00,0x00,0x00,0x00,0x00,0x00,0x00,0x00,0x00,0x00,0x00,0x00,0x00,0x00,0x00,0x00,0x00,0x00,0x00,0x00,0x00,0x00,0x00,0x00,0x00,0x00,0x00,0x00,0x00,0x00,0x00,0x00,0x00,0x00,0x00,0x00,0x00,0x00,0x00,0x00,0x00,0x00,0x00,0x00,0x00,0x00,0x00,0x00,0x00,0x00,0x00,0x00,0x00,0x00,0x00,0x00,0x00,0x00,0x00,0x00,0x00,0x00,0x00,0x00,0x00,0x00,0x00,0x00,0x00,0x00,0x00,0x00,0x00,0x00,0x00,0x00,0x00,0x00,0x00,0x00,0x00,0x00,0x00,0x00,0x00,0x00,0x00,0x00,0x00,0x00,0x00,0x00,0x00,0x00,0x00,0x00,0x00,0x00,0x00,0x00,0x00,0x00,0x00,0x00,0x00,
    };
const lv_img_dsc_t ui_img_thunder_png = {
   .header.always_zero = 0,
   .header.w = 40,
   .header.h = 40,
   .data_size = sizeof(ui_img_thunder_png_data),
   .header.cf = LV_IMG_CF_TRUE_COLOR_ALPHA,
   .data = ui_img_thunder_png_data};

