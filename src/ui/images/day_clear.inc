/**
 * @file day_clear.c
 * @brief LVGL image asset with multi-format support
 *
 * Generated by PicoPixel.io — https://picopixel.io
 *
 * Image: day_clear
 * Size: 40 x 40 pixels
 * Has transparency: Yes
 *
 * Color format is selected at compile time based on LV_COLOR_DEPTH:
 * - LV_COLOR_DEPTH == 32: ARGB8888 (best quality, full alpha)
 * - LV_COLOR_DEPTH == 16 with alpha: RGB565A8 (16-bit color + 8-bit alpha)
 * - LV_COLOR_DEPTH == 16 without alpha: RGB565
 */

#ifdef __has_include
    #if __has_include("lvgl.h")
        #ifndef LV_LVGL_H_INCLUDE_SIMPLE
            #define LV_LVGL_H_INCLUDE_SIMPLE
        #endif
    #endif
#endif

#if defined(LV_LVGL_H_INCLUDE_SIMPLE)
    #include "lvgl.h"
#else
    #include "lvgl/lvgl.h"
#endif

#ifndef LV_ATTRIBUTE_MEM_ALIGN
#define LV_ATTRIBUTE_MEM_ALIGN
#endif

#ifndef LV_ATTRIBUTE_LARGE_CONST
#define LV_ATTRIBUTE_LARGE_CONST
#endif

#ifndef LV_ATTRIBUTE_IMG_DAY_CLEAR
#define LV_ATTRIBUTE_IMG_DAY_CLEAR
#endif

#ifndef LV_COLOR_16_SWAP
#define LV_COLOR_16_SWAP 0
#endif

/* ============================================================================
 * TRUE_COLOR_ALPHA (ARGB8888) - 32-bit displays with full alpha support
 * ============================================================================ */
#if LV_COLOR_DEPTH == 32

static const LV_ATTRIBUTE_MEM_ALIGN LV_ATTRIBUTE_LARGE_CONST LV_ATTRIBUTE_IMG_DAY_CLEAR uint8_t day_clear_argb8888_map[] = {
    0x00, 0x00, 0x00, 0x00, 0x00, 0x00, 0x00, 0x00, 0x00, 0x00, 0x00, 0x00, 0x00, 0x00, 0x00, 0x00,
    0x00, 0x00, 0x00, 0x00, 0x00, 0x00, 0x00, 0x00, 0x00, 0x00, 0x00, 0x00, 0x00, 0x00, 0x00, 0x00,
    0x00, 0x00, 0x00, 0x00, 0x00, 0x00, 0x00, 0x00, 0x00, 0x00, 0x00, 0x00, 0x00, 0x00, 0x00, 0x00,
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    0x00, 0x00, 0x00, 0x00, 0x00, 0x00, 0x00, 0x00, 0x00, 0x00, 0x00, 0x00, 0x00, 0x00, 0x00, 0x00,
};

#elif LV_COLOR_DEPTH == 16

/* ============================================================================
 * 16-bit display formats
 * ============================================================================ */

#if LV_COLOR_16_SWAP == 0
/* RGB565A8 - 16-bit color with separate 8-bit alpha channel (standard byte order) */

static const LV_ATTRIBUTE_MEM_ALIGN LV_ATTRIBUTE_LARGE_CONST LV_ATTRIBUTE_IMG_DAY_CLEAR uint8_t day_clear_rgb565a8_map[] = {
    /* RGB565 color data (3200 bytes) */
    0x00, 0x00, 0x00, 0x00, 0x00, 0x00, 0x00, 0x00, 0x00, 0x00, 0x00, 0x00, 0x00, 0x00, 0x00, 0x00,
    0x00, 0x00, 0x00, 0x00, 0x00, 0x00, 0x00, 0x00, 0x00, 0x00, 0x00, 0x00, 0x00, 0x00, 0x00, 0x00,
    0x00, 0x00, 0x00, 0x00, 0x00, 0x00, 0x00, 0x00, 0x00, 0x00, 0x00, 0x00, 0x00, 0x00, 0x00, 0x00,
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    0x00, 0x00, 0x00, 0x00, 0x00, 0x00, 0x00, 0x00, 0x00, 0x00, 0x00, 0x00, 0x00, 0x00, 0x00, 0x00,
    /* Alpha channel data (1600 bytes) */
    0x00, 0x00, 0x00, 0x00, 0x00, 0x00, 0x00, 0x00, 0x00, 0x00, 0x00, 0x00, 0x00, 0x00, 0x00, 0x00,
    0x00, 0x00, 0x00, 0x00, 0x00, 0x00, 0x00, 0x00, 0x22, 0x8d, 0x42, 0x00, 0x00, 0x00, 0x00, 0x00,
    0x00, 0x00, 0x00, 0x00, 0x00, 0x00, 0x00, 0x00, 0x00, 0x00, 0x00, 0x00, 0x00, 0x00, 0x00, 0x00,
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    0x00, 0x00, 0x00, 0x00, 0x00, 0x00, 0x00, 0x00, 0x00, 0x00, 0x00, 0x00, 0x00, 0x00, 0x00, 0x00,
};
#else
/* RGB565A8 - 16-bit color with separate 8-bit alpha channel (swapped byte order) */

static const LV_ATTRIBUTE_MEM_ALIGN LV_ATTRIBUTE_LARGE_CONST LV_ATTRIBUTE_IMG_DAY_CLEAR uint8_t day_clear_rgb565a8_swap_map[] = {
    /* RGB565 color data (3200 bytes, byte-swapped) */
    0x00, 0x00, 0x00, 0x00, 0x00, 0x00, 0x00, 0x00, 0x00, 0x00, 0x00, 0x00, 0x00, 0x00, 0x00, 0x00,
    0x00, 0x00, 0x00, 0x00, 0x00, 0x00, 0x00, 0x00, 0x00, 0x00, 0x00, 0x00, 0x00, 0x00, 0x00, 0x00,
    0x00, 0x00, 0x00, 0x00, 0x00, 0x00, 0x00, 0x00, 0x00, 0x00, 0x00, 0x00, 0x00, 0x00, 0x00, 0x00,
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    0x00, 0x00, 0x00, 0x00, 0x00, 0x00, 0x00, 0x00, 0x00, 0x00, 0x00, 0x00, 0x00, 0x00, 0x00, 0x00,
    /* Alpha channel data (1600 bytes) */
    0x00, 0x00, 0x00, 0x00, 0x00, 0x00, 0x00, 0x00, 0x00, 0x00, 0x00, 0x00, 0x00, 0x00, 0x00, 0x00,
    0x00, 0x00, 0x00, 0x00, 0x00, 0x00, 0x00, 0x00, 0x22, 0x8d, 0x42, 0x00, 0x00, 0x00, 0x00, 0x00,
    0x00, 0x00, 0x00, 0x00, 0x00, 0x00, 0x00, 0x00, 0x00, 0x00, 0x00, 0x00, 0x00, 0x00, 0x00, 0x00,
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    0x00, 0x00, 0x00, 0x00, 0x00, 0x00, 0x00, 0x00, 0x00, 0x00, 0x00, 0x00, 0x00, 0x00, 0x00, 0x00,
};
#endif


#elif LV_COLOR_DEPTH == 8

#error "8-bit color depth (LV_COLOR_DEPTH == 8) is not yet supported for image export. Use 16 or 32-bit."

#else
#error "Unsupported LV_COLOR_DEPTH. Please use 16 or 32."
#endif

const lv_img_dsc_t day_clear = {
#if LV_COLOR_DEPTH == 32
    .header.cf = LV_IMG_CF_TRUE_COLOR_ALPHA,
    .header.always_zero = 0,
    .header.reserved = 0,
    .header.w = 40,
    .header.h = 40,
    .data_size = 6400,
    .data = day_clear_argb8888_map,
#elif LV_COLOR_DEPTH == 16
    .header.cf = LV_IMG_CF_RGB565A8,
    .header.always_zero = 0,
    .header.reserved = 0,
    .header.w = 40,
    .header.h = 40,
    .data_size = 4800, /* RGB565 (3200) + Alpha (1600) */
#if LV_COLOR_16_SWAP == 0
    .data = day_clear_rgb565a8_map,
#else
    .data = day_clear_rgb565a8_swap_map,
#endif
#endif
};
